## boards/shields/xiao40/Kconfig.defconfig
```kconfig
# Copyright (c) 2022 The ZMK Contributors
# SPDX-License-Identifier: MIT

if SHIELD_XIAO40

config ZMK_KEYBOARD_NAME
    default "Xiao40"

config SPI
    default y

endif
```

## boards/shields/xiao40/Kconfig.shield
```kconfig
# Copyright (c) 2022 Ramon Imbao
# SPDX-License-Identifier: MIT

config SHIELD_XIAO40
   def_bool $(shields_list_contains,xiao40)
```
